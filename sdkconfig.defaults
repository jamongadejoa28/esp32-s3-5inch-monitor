## sdkconfig.defaults
```kconfig
CONFIG_IDF_TARGET="esp32s3"
CONFIG_ESPTOOLPY_FLASHSIZE_16MB=y
CONFIG_ESP_DEFAULT_CPU_FREQ_MHZ_240=y
CONFIG_SPIRAM=y
CONFIG_SPIRAM_MODE_OCT=y
CONFIG_SPIRAM_SPEED_80M=y
CONFIG_SPIRAM_XIP_FROM_PSRAM=y
CONFIG_ESP32S3_INSTRUCTION_CACHE_32KB=y
CONFIG_ESP32S3_DATA_CACHE_64KB=y
CONFIG_ESP32S3_DATA_CACHE_LINE_64B=y
CONFIG_SPIRAM_USE_MALLOC=y
CONFIG_SPIRAM_MALLOC_ALWAYSINTERNAL=16384
CONFIG_PARTITION_TABLE_CUSTOM=y
CONFIG_PARTITION_TABLE_CUSTOM_FILENAME="partitions.csv"
CONFIG_ESP_CONSOLE_USB_SERIAL_JTAG=y
CONFIG_FREERTOS_HZ=1000
CONFIG_COMPILER_OPTIMIZATION_PERF=y
CONFIG_ESP_MAIN_TASK_STACK_SIZE=24576
CONFIG_FREERTOS_CHECK_STACKOVERFLOW_CANARY=y
CONFIG_FREERTOS_WATCHPOINT_END_OF_STACK=y
CONFIG_COMPILER_STACK_CHECK_MODE_STRONG=y
CONFIG_LCD_RGB_RESTART_IN_VSYNC=y
CONFIG_LV_CONF_SKIP=n

CONFIG_LV_MEM_SIZE_KILOBYTES=0

CONFIG_LV_ASSERT_HANDLER_INCLUDE=""

# CONFIG_LV_BUILD_EXAMPLES is not set

# CONFIG_LV_BUILD_DEMOS is not set

# CONFIG_LV_USE_BUILTIN_MALLOC is not set

CONFIG_LV_USE_CLIB_MALLOC=y

# CONFIG_LV_USE_BUILTIN_STRING is not set

CONFIG_LV_USE_CLIB_STRING=y

# CONFIG_LV_USE_BUILTIN_SPRINTF is not set

CONFIG_LV_USE_CLIB_SPRINTF=y
```
